## sdkconfig.defaults
```kconfig
# Wi-Fi TX buffer headroom
CONFIG_ESP_WIFI_DYNAMIC_TX_BUFFER_NUM=128

# lwIP pbuf pool (UDP uses these) – gives enough for brief bursts
CONFIG_LWIP_PBUF_POOL_SIZE=512

CONFIG_COMPILER_CXX_RTTI=y
CONFIG_COMPILER_CXX_EXCEPTIONS=y

CONFIG_ESPTOOLPY_FLASHSIZE_8MB=y
CONFIG_ESPTOOLPY_FLASHSIZE="8MB"

CONFIG_PARTITION_TABLE_CUSTOM=y
CONFIG_PARTITION_TABLE_FILENAME="partitions.csv"   # or your file name
CONFIG_PARTITION_TABLE_OFFSET=0x8000
```
